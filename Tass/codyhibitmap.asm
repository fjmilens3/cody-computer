;
; codyhichar.asm
; A high-resolution bitmap demo displaying a full bitmap graphic.
;
; The image is from "Scumm Bar" by Alakran. Copyright remains with the
; original author.
;
; Copyright 2025 Frederick John Milens III, The Cody Computer Developers.
;
; This program is free software; you can redistribute it and/or
; modify it under the terms of the GNU General Public License
; as published by the Free Software Foundation; either version 3
; of the License, or (at your option) any later version.
;
; This program is distributed in the hope that it will be useful,
; but WITHOUT ANY WARRANTY; without even the implied warranty of
; MERCHANTABILITY or FITNESS FOR A PARTICULAR PURPOSE.  See the
; GNU General Public License for more details.
;
; You should have received a copy of the GNU General Public License
; along with this program; if not, write to the Free Software
; Foundation, Inc., 51 Franklin Street, Fifth Floor, Boston, MA 02110-1301, USA.
;
; To assemble using 64TASS run the following:
;
;   64tass --mw65c02 --nostart -o codyhibitmap.bin codyhibitmap.asm
;
ADDR      = $0300               ; The actual loading address of the program

SCRRAM    = $A000               ; Screen memory location
COLRAM    = $D800               ; Color memory location

VIA_BASE  = $9F00               ; VIA base address and register locations
VIA_IORB  = VIA_BASE+$0
VIA_IORA  = VIA_BASE+$1
VIA_DDRB  = VIA_BASE+$2
VIA_DDRA  = VIA_BASE+$3
VIA_T1CL  = VIA_BASE+$4
VIA_T1CH  = VIA_BASE+$5
VIA_SR    = VIA_BASE+$A
VIA_ACR   = VIA_BASE+$B
VIA_PCR   = VIA_BASE+$C
VIA_IFR   = VIA_BASE+$D
VIA_IER   = VIA_BASE+$E

VID_BLNK  = $D000               ; Video blanking status register
VID_CNTL  = $D001               ; Video control register
VID_COLR  = $D002               ; Video color register
VID_BPTR  = $D003               ; Video base pointer register
VID_SCRL  = $D004               ; Video scroll register
VID_SCRC  = $D005               ; Video screen common colors register
VID_SPRC  = $D006               ; Video sprite control register

; Variables

MEMSPTR   = $20       ; The source pointer for memory-related utility routines (2 bytes)
MEMDPTR   = $22       ; The destination pointer for memory-related utility routines (2 bytes)
MEMSIZE   = $24       ; The size of memory to move for memory-related utility routines (2 bytes)

; Program header for Cody Basic's loader (needs to be first)

.WORD ADDR                      ; Starting address (just like KIM-1, Commodore, etc.)
.WORD (ADDR + LAST - MAIN - 1)  ; Ending address (so we know when we're done loading)

; The actual program goes below here

.LOGICAL    ADDR                ; The actual program gets loaded at ADDR

;
; MAIN
;
; The starting point of the demo. Sets up the VID and copies all the data.
; Once the data is in place the high-resolution character mode is enabled.
;
MAIN        LDA #<SCREEN_DATA     ; Copy the screen data
            STA MEMSPTR

            LDA #>SCREEN_DATA
            STA MEMSPTR+1

            LDA #<SCRRAM
            STA MEMDPTR

            LDA #>SCRRAM
            STA MEMDPTR+1

            LDA #<8192
            STA MEMSIZE

            LDA #>8192
            STA MEMSIZE+1
            
            JSR MEMCOPYUP
            
            LDA #<COLOR_DATA      ; Copy the color data
            STA MEMSPTR

            LDA #>COLOR_DATA
            STA MEMSPTR+1

            LDA #<COLRAM
            STA MEMDPTR

            LDA #>COLRAM
            STA MEMDPTR+1

            LDA #<1024
            STA MEMSIZE

            LDA #>1024
            STA MEMSIZE+1
            
            JSR MEMCOPYUP

            LDA #$E1            ; Point the video hardware to default color memory, border color white
            STA VID_COLR
  
            LDA #$05            ; Point the video hardware to the screen memory and default character set
            STA VID_BPTR

            LDA VID_CNTL        ; Set high resolution bitmap graphics mode
            ORA #$30
            STA VID_CNTL
          
_DONE       BRA _DONE           ; Loop forever (TODO: For now...)
            
;
; MEMCOPYUP
;
; Copies a region of memory upward. This routine should be used if the destination address
; is higher in memory than the source address. Copies a total of MEMSIZE bytes from MEMSPTR 
; to MEMDPTR.
;
; Algorithm copied from http://www.6502.org/source/general/memory_move.html.
;
; Uses:
;
;   MEMSPTR       Source pointer (modified by operation)
;   MEMDPTR       Destination pointer (modified by operation)
;   MEMSIZE       Bytes to copy (modified by operation) 
;
MEMCOPYUP PHA
          PHX
          PHY

          LDX MEMSIZE+1     ; the last byte must be moved first
          CLC               ; start at the final pages of FROM and TO
          TXA
          ADC MEMSPTR+1
          STA MEMSPTR+1
          CLC
          TXA
          ADC MEMDPTR+1
          STA MEMDPTR+1
          INX               ; allows the use of BNE after the DEX below
          LDY MEMSIZE
          BEQ _NEXT
          DEY               ; move bytes on the last page first
          BEQ _ONCE

_LOOP     LDA (MEMSPTR),Y
          STA (MEMDPTR),Y
          DEY
          BNE _LOOP

_ONCE     LDA (MEMSPTR),Y   ; handle Y = 0 separately
          STA (MEMDPTR),Y
  
_NEXT     DEY
          DEC MEMSPTR+1     ; move the next page (if any)
          DEC MEMDPTR+1
          DEX
          BNE _LOOP

          PLY
          PLX
          PLA
        
          RTS

;
; Screen RAM data from "Scumm Bar" by Alakran. See
; https://csdb.dk/release/?id=230302 for the source. The
; copyright remains with the original author.
;
SCREEN_DATA

  .BYTE $00,$00,$00,$00,$00,$00,$00,$01
  .BYTE $ff,$ff,$ff,$f0,$c0,$80,$00,$00
  .BYTE $00,$00,$00,$e0,$f8,$fc,$fe,$ff
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  .BYTE $ff,$ff,$ff,$ff,$ff,$ff,$ff,$ff

;
; Screen RAM data from "Scumm Bar" by Alakran. See
; https://csdb.dk/release/?id=230302 for the source. The
; copyright remains with the original author.
;
COLOR_DATA

  .BYTE $31,$13,$31,$01,$01,$01,$01,$01
  .BYTE $01,$01,$01,$01,$01,$01,$31,$31
  .BYTE $31,$31,$31,$31,$31,$31,$31,$31
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  .BYTE $20,$21,$22,$23,$24,$25,$26,$27

LAST                              ; End of the entire program
      
.ENDLOGICAL
