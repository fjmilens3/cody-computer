;
; codybitmap.asm
; A bitmap demo displaying a converted piece of Commodore 64 multicolor art.
;
; The image is from "Space: The Ultimate Frontier" by Dave Neale and Ufland
; Software. Copyright on the image remains with its original owners and
; is used here both to show the level of compatibility with the C64 and for
; sentimental reasons. (My dad and I played the game when I was a kid.)
;
; Copyright 2024 Frederick John Milens III, The Cody Computer Developers.
;
; This program is free software; you can redistribute it and/or
; modify it under the terms of the GNU General Public License
; as published by the Free Software Foundation; either version 3
; of the License, or (at your option) any later version.
;
; This program is distributed in the hope that it will be useful,
; but WITHOUT ANY WARRANTY; without even the implied warranty of
; MERCHANTABILITY or FITNESS FOR A PARTICULAR PURPOSE.  See the
; GNU General Public License for more details.
;
; You should have received a copy of the GNU General Public License
; along with this program; if not, write to the Free Software
; Foundation, Inc., 51 Franklin Street, Fifth Floor, Boston, MA 02110-1301, USA.
;
; To assemble using 64TASS run the following:
;
;   64tass --mw65c02 --nostart -o codybitmap.bin codybitmap.asm
;
ADDR      = $0300               ; The actual loading address of the program

SCRRAM    = $A000               ; Screen memory location
COLRAM    = $D800               ; Color memory location

VIA_BASE  = $9F00               ; VIA base address and register locations
VIA_IORB  = VIA_BASE+$0
VIA_IORA  = VIA_BASE+$1
VIA_DDRB  = VIA_BASE+$2
VIA_DDRA  = VIA_BASE+$3
VIA_T1CL  = VIA_BASE+$4
VIA_T1CH  = VIA_BASE+$5
VIA_SR    = VIA_BASE+$A
VIA_ACR   = VIA_BASE+$B
VIA_PCR   = VIA_BASE+$C
VIA_IFR   = VIA_BASE+$D
VIA_IER   = VIA_BASE+$E

VID_BLNK  = $D000               ; Video blanking status register
VID_CNTL  = $D001               ; Video control register
VID_COLR  = $D002               ; Video color register
VID_BPTR  = $D003               ; Video base pointer register
VID_SCRL  = $D004               ; Video scroll register
VID_SCRC  = $D005               ; Video screen common colors register
VID_SPRC  = $D006               ; Video sprite control register

; Variables

MEMSPTR   = $20       ; The source pointer for memory-related utility routines (2 bytes)
MEMDPTR   = $22       ; The destination pointer for memory-related utility routines (2 bytes)
MEMSIZE   = $24       ; The size of memory to move for memory-related utility routines (2 bytes)

; Program header for Cody Basic's loader (needs to be first)

.WORD ADDR                      ; Starting address (just like KIM-1, Commodore, etc.)
.WORD (ADDR + LAST - MAIN - 1)  ; Ending address (so we know when we're done loading)

; The actual program goes below here

.LOGICAL    ADDR                ; The actual program gets loaded at ADDR

;
; MAIN
;
; The starting point of the demo. Sets up the VID and copies bitmap and color data.
;
MAIN        LDA #<BITMAP_DATA   ; Copy the screen memory
            STA MEMSPTR

            LDA #>BITMAP_DATA
            STA MEMSPTR+1

            LDA #<SCRRAM
            STA MEMDPTR

            LDA #>SCRRAM
            STA MEMDPTR+1

            LDA #<8000
            STA MEMSIZE

            LDA #>8000
            STA MEMSIZE+1
            
            JSR MEMCOPYUP
            
            LDA #<COLORS_DATA   ; Copy the color memory
            STA MEMSPTR

            LDA #>COLORS_DATA
            STA MEMSPTR+1

            LDA #<COLRAM
            STA MEMDPTR

            LDA #>COLRAM
            STA MEMDPTR+1

            LDA #<1000
            STA MEMSIZE

            LDA #>1000
            STA MEMSIZE+1

            JSR MEMCOPYUP
            
            LDA #$60            ; Set shared colors (blue and black)
            STA VID_SCRC

            LDA #$E0            ; Point the video hardware to default color memory, border color black
            STA VID_COLR
  
            LDA #$05            ; Point the video hardware to the screen memory and default character set
            STA VID_BPTR

            LDA VID_CNTL        ; Set bitmap graphics mode
            ORA #$10
            STA VID_CNTL
          
_DONE       BRA _DONE           ; Loop forever (TODO: For now...)

;
; MEMCOPYUP
;
; Copies a region of memory upward. This routine should be used if the destination address
; is higher in memory than the source address. Copies a total of MEMSIZE bytes from MEMSPTR 
; to MEMDPTR.
;
; Algorithm copied from http://www.6502.org/source/general/memory_move.html.
;
; Uses:
;
;   MEMSPTR       Source pointer (modified by operation)
;   MEMDPTR       Destination pointer (modified by operation)
;   MEMSIZE       Bytes to copy (modified by operation) 
;
MEMCOPYUP PHA
          PHX
          PHY

          LDX MEMSIZE+1     ; the last byte must be moved first
          CLC               ; start at the final pages of FROM and TO
          TXA
          ADC MEMSPTR+1
          STA MEMSPTR+1
          CLC
          TXA
          ADC MEMDPTR+1
          STA MEMDPTR+1
          INX               ; allows the use of BNE after the DEX below
          LDY MEMSIZE
          BEQ _NEXT
          DEY               ; move bytes on the last page first
          BEQ _ONCE

_LOOP     LDA (MEMSPTR),Y
          STA (MEMDPTR),Y
          DEY
          BNE _LOOP

_ONCE     LDA (MEMSPTR),Y   ; handle Y = 0 separately
          STA (MEMDPTR),Y
  
_NEXT     DEY
          DEC MEMSPTR+1     ; move the next page (if any)
          DEC MEMDPTR+1
          DEX
          BNE _LOOP

          PLY
          PLX
          PLA
        
          RTS

;
; Converted bitmap data. The original image is from "Space: The Ultimate Frontier"
; by Dave Neale (visit https://www.lemon64.com/game/space-the-ultimate-frontier).
;
BITMAP_DATA

  .BYTE $aa,$aa,$a8,$a1,$84,$12,$12,$12
  .BYTE $aa,$aa,$00,$55,$00,$aa,$a8,$a1
  .BYTE $aa,$aa,$00,$55,$00,$15,$40,$2a
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  .BYTE $00,$00,$00,$00,$00,$00,$00,$00

;
; Converted color memory data for the bitmap image.
;
COLORS_DATA
  
  .BYTE $7c,$7c,$7c,$7c,$7c,$0b,$60,$60
  .BYTE $0b,$0b,$b7,$07,$b7,$07,$c7,$b7
  .BYTE $b7,$07,$60,$0b,$07,$cb,$60,$0b
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  .BYTE $06,$06,$06,$60,$0b,$60,$60,$60

LAST                              ; End of the entire program
      
.ENDLOGICAL
